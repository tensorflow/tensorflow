## tensorflow/lite/micro/examples/micro_speech/esp/sdkconfig.defaults
```kconfig
CONFIG_ESP32_DEFAULT_CPU_FREQ_MHZ=240
CONFIG_FLASHMODE_QIO=y
CONFIG_ESPTOOLPY_FLASHFREQ_80M=y
CONFIG_INT_WDT=
CONFIG_TASK_WDT=
CONFIG_COMPILER_OPTIMIZATION_PERF=y
```

## tensorflow/lite/micro/examples/person_detection/esp/main/Kconfig.projbuild
```kconfig
menu "Camera Pins"
choice CAMERA_MODEL
    bool "Select Camera Pinout"
    default CAMERA_MODEL_WROVER_KIT
    help
        Select Camera Pinout.

config CAMERA_MODEL_WROVER_KIT
    bool "WROVER-KIT With OV2640 Module"
config CAMERA_MODEL_ESP_EYE
    bool "ESP_EYE DevKit"
config CAMERA_MODEL_M5STACK_PSRAM
    bool "M5Stack Camera With PSRAM"
config CAMERA_MODEL_M5STACK_WIDE
    bool "M5Stack Camera F (Wide)"
config CAMERA_MODEL_AI_THINKER
    bool "ESP32-CAM by AI-Thinker"
config CAMERA_MODEL_CUSTOM
    bool "Custom Camera Pinout"
endchoice

config CAMERA_PIN_PWDN
    depends on CAMERA_MODEL_CUSTOM
    int "Power Down pin"
    range -1 33
    default -1
    help
        Select Power Down pin or -1 for unmanaged.

config CAMERA_PIN_RESET
    depends on CAMERA_MODEL_CUSTOM
    int "Reset pin"
    range -1 33
    default -1
    help
        Select Camera Reset pin or -1 for software reset.

config CAMERA_PIN_XCLK
    depends on CAMERA_MODEL_CUSTOM
    int "XCLK pin"
    range 0 33
    default 21
    help
        Select Camera XCLK pin.

config CAMERA_PIN_SIOD
    depends on CAMERA_MODEL_CUSTOM
    int "SIOD pin"
    range 0 33
    default 26
    help
        Select Camera SIOD pin.

config CAMERA_PIN_SIOC
    depends on CAMERA_MODEL_CUSTOM
    int "SIOC pin"
    range 0 33
    default 27
    help
        Select Camera SIOC pin.

config CAMERA_PIN_VSYNC
    depends on CAMERA_MODEL_CUSTOM
    int "VSYNC pin"
    range 0 39
    default 25
    help
        Select Camera VSYNC pin.

config CAMERA_PIN_HREF
    depends on CAMERA_MODEL_CUSTOM
    int "HREF pin"
    range 0 39
    default 23
    help
        Select Camera HREF pin.

config CAMERA_PIN_PCLK
    depends on CAMERA_MODEL_CUSTOM
    int "PCLK pin"
    range 0 39
    default 25
    help
        Select Camera PCLK pin.

config CAMERA_PIN_Y2
    depends on CAMERA_MODEL_CUSTOM
    int "Y2 pin"
    range 0 39
    default 4
    help
        Select Camera Y2 pin.

config CAMERA_PIN_Y3
    depends on CAMERA_MODEL_CUSTOM
    int "Y3 pin"
    range 0 39
    default 5
    help
        Select Camera Y3 pin.

config CAMERA_PIN_Y4
    depends on CAMERA_MODEL_CUSTOM
    int "Y4 pin"
    range 0 39
    default 18
    help
        Select Camera Y4 pin.

config CAMERA_PIN_Y5
    depends on CAMERA_MODEL_CUSTOM
    int "Y5 pin"
    range 0 39
    default 19
    help
        Select Camera Y5 pin.

config CAMERA_PIN_Y6
    depends on CAMERA_MODEL_CUSTOM
    int "Y6 pin"
    range 0 39
    default 36
    help
        Select Camera Y6 pin.

config CAMERA_PIN_Y7
    depends on CAMERA_MODEL_CUSTOM
    int "Y7 pin"
    range 0 39
    default 39
    help
        Select Camera Y7 pin.

config CAMERA_PIN_Y8
    depends on CAMERA_MODEL_CUSTOM
    int "Y8 pin"
    range 0 39
    default 34
    help
        Select Camera Y8 pin.

config CAMERA_PIN_Y9
    depends on CAMERA_MODEL_CUSTOM
    int "Y9 pin"
    range 0 39
    default 35
    help
        Select Camera Y9 pin.

endmenu
```

## tensorflow/lite/micro/examples/person_detection/esp/sdkconfig.defaults
```kconfig
# Copyright 2020 The TensorFlow Authors. All Rights Reserved.
#
# Licensed under the Apache License, Version 2.0 (the "License");
# you may not use this file except in compliance with the License.
# You may obtain a copy of the License at
#
#    http://www.apache.org/licenses/LICENSE-2.0
#
# Unless required by applicable law or agreed to in writing, software
# distributed under the License is distributed on an "AS IS" BASIS,
# WITHOUT WARRANTIES OR CONDITIONS OF ANY KIND, either express or implied.
# See the License for the specific language governing permissions and
# limitations under the License.

CONFIG_ESPTOOLPY_BAUD_115200B=
CONFIG_ESPTOOLPY_BAUD_230400B=
CONFIG_ESPTOOLPY_BAUD_921600B=y
CONFIG_ESPTOOLPY_BAUD_2MB=
CONFIG_ESPTOOLPY_BAUD_OTHER=
CONFIG_ESPTOOLPY_BAUD_OTHER_VAL=115200
CONFIG_ESPTOOLPY_BAUD=921600
CONFIG_ESPTOOLPY_COMPRESSED=y
CONFIG_FLASHMODE_QIO=y
CONFIG_FLASHMODE_QOUT=
CONFIG_FLASHMODE_DIO=
CONFIG_FLASHMODE_DOUT=
CONFIG_ESPTOOLPY_FLASHMODE="dio"
CONFIG_ESPTOOLPY_FLASHFREQ_80M=y
CONFIG_ESPTOOLPY_FLASHFREQ_40M=
CONFIG_ESPTOOLPY_FLASHFREQ_26M=
CONFIG_ESPTOOLPY_FLASHFREQ_20M=
CONFIG_ESPTOOLPY_FLASHFREQ="80m"
CONFIG_ESPTOOLPY_FLASHSIZE_1MB=
CONFIG_ESPTOOLPY_FLASHSIZE_2MB=
CONFIG_ESPTOOLPY_FLASHSIZE_4MB=y
CONFIG_ESPTOOLPY_FLASHSIZE_8MB=
CONFIG_ESPTOOLPY_FLASHSIZE_16MB=
CONFIG_ESPTOOLPY_FLASHSIZE="4MB"
CONFIG_ESPTOOLPY_FLASHSIZE_DETECT=y
CONFIG_ESPTOOLPY_BEFORE_RESET=y
CONFIG_ESPTOOLPY_BEFORE_NORESET=
CONFIG_ESPTOOLPY_BEFORE="default_reset"
CONFIG_ESPTOOLPY_AFTER_RESET=y
CONFIG_ESPTOOLPY_AFTER_NORESET=
CONFIG_ESPTOOLPY_AFTER="hard_reset"
CONFIG_MONITOR_BAUD_9600B=
CONFIG_MONITOR_BAUD_57600B=
CONFIG_MONITOR_BAUD_115200B=y
CONFIG_MONITOR_BAUD_230400B=
CONFIG_MONITOR_BAUD_921600B=
CONFIG_MONITOR_BAUD_2MB=
CONFIG_MONITOR_BAUD_OTHER=
CONFIG_MONITOR_BAUD_OTHER_VAL=115200
CONFIG_MONITOR_BAUD=115200
CONFIG_COMPILER_OPTIMIZATION_PERF=y

# Camera configuration
#
CONFIG_ENABLE_TEST_PATTERN=
CONFIG_OV2640_SUPPORT=y
CONFIG_OV7725_SUPPORT=

#
# ESP32-specific
#
CONFIG_ESP32_DEFAULT_CPU_FREQ_80=
CONFIG_ESP32_DEFAULT_CPU_FREQ_160=
CONFIG_ESP32_DEFAULT_CPU_FREQ_240=y
CONFIG_ESP32_DEFAULT_CPU_FREQ_MHZ=240

#
# SPI RAM config
#
CONFIG_SPIRAM_BOOT_INIT=y
CONFIG_SPIRAM_IGNORE_NOTFOUND=
CONFIG_SPIRAM_USE_MEMMAP=
CONFIG_SPIRAM_USE_CAPS_ALLOC=y
CONFIG_SPIRAM_USE_MALLOC=
CONFIG_SPIRAM_TYPE_AUTO=y
CONFIG_SPIRAM_TYPE_ESPPSRAM32=
CONFIG_SPIRAM_TYPE_ESPPSRAM64=
CONFIG_SPIRAM_SIZE=-1
CONFIG_SPIRAM_SPEED_40M=
CONFIG_SPIRAM_SPEED_80M=y
CONFIG_SPIRAM_MEMTEST=y
CONFIG_SPIRAM_CACHE_WORKAROUND=y
CONFIG_SPIRAM_BANKSWITCH_ENABLE=y
CONFIG_SPIRAM_BANKSWITCH_RESERVE=8
CONFIG_WIFI_LWIP_ALLOCATION_FROM_SPIRAM_FIRST=
CONFIG_SPIRAM_ALLOW_BSS_SEG_EXTERNAL_MEMORY=

CONFIG_TASK_WDT=

#For no set the camera module as ESP-EYE
CONFIG_CAMERA_MODEL_ESP_EYE=y
CONFIG_RTCIO_SUPPORT_RTC_GPIO_DESC=y
```
