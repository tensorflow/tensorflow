
/* Copyright 2021 The TensorFlow Authors. All Rights Reserved.

Licensed under the Apache License, Version 2.0 (the "License");
you may not use this file except in compliance with the License.
You may obtain a copy of the License at

    http://www.apache.org/licenses/LICENSE-2.0

Unless required by applicable law or agreed to in writing, software
distributed under the License is distributed on an "AS IS" BASIS,
WITHOUT WARRANTIES OR CONDITIONS OF ANY KIND, either express or implied.
See the License for the specific language governing permissions and
limitations under the License.
==============================================================================*/

// DO NOT EDIT MANUALLY: This file is automatically generated by
// `tensorflow/lite/schema/builtin_ops_list/generator.cc`.

TFLITE_OP(Register_ADD)
TFLITE_OP(Register_AVERAGE_POOL_2D)
TFLITE_OP(Register_CONCATENATION)
TFLITE_OP(Register_CONV_2D)
TFLITE_OP(Register_DEPTHWISE_CONV_2D)
TFLITE_OP(Register_DEPTH_TO_SPACE)
TFLITE_OP(Register_DEQUANTIZE)
TFLITE_OP(Register_EMBEDDING_LOOKUP)
TFLITE_OP(Register_FLOOR)
TFLITE_OP(Register_FULLY_CONNECTED)
TFLITE_OP(Register_HASHTABLE_LOOKUP)
TFLITE_OP(Register_L2_NORMALIZATION)
TFLITE_OP(Register_L2_POOL_2D)
TFLITE_OP(Register_LOCAL_RESPONSE_NORMALIZATION)
TFLITE_OP(Register_LOGISTIC)
TFLITE_OP(Register_LSH_PROJECTION)
TFLITE_OP(Register_LSTM)
TFLITE_OP(Register_MAX_POOL_2D)
TFLITE_OP(Register_MUL)
TFLITE_OP(Register_RELU)
TFLITE_OP(Register_RELU_N1_TO_1)
TFLITE_OP(Register_RELU6)
TFLITE_OP(Register_RESHAPE)
TFLITE_OP(Register_RESIZE_BILINEAR)
TFLITE_OP(Register_RNN)
TFLITE_OP(Register_SOFTMAX)
TFLITE_OP(Register_SPACE_TO_DEPTH)
TFLITE_OP(Register_SVDF)
TFLITE_OP(Register_TANH)
TFLITE_OP(Register_SKIP_GRAM)
TFLITE_OP(Register_EMBEDDING_LOOKUP_SPARSE)
TFLITE_OP(Register_PAD)
TFLITE_OP(Register_UNIDIRECTIONAL_SEQUENCE_RNN)
TFLITE_OP(Register_GATHER)
TFLITE_OP(Register_BATCH_TO_SPACE_ND)
TFLITE_OP(Register_SPACE_TO_BATCH_ND)
TFLITE_OP(Register_TRANSPOSE)
TFLITE_OP(Register_MEAN)
TFLITE_OP(Register_SUB)
TFLITE_OP(Register_DIV)
TFLITE_OP(Register_SQUEEZE)
TFLITE_OP(Register_UNIDIRECTIONAL_SEQUENCE_LSTM)
TFLITE_OP(Register_STRIDED_SLICE)
TFLITE_OP(Register_BIDIRECTIONAL_SEQUENCE_RNN)
TFLITE_OP(Register_EXP)
TFLITE_OP(Register_TOPK_V2)
TFLITE_OP(Register_SPLIT)
TFLITE_OP(Register_LOG_SOFTMAX)
TFLITE_OP(Register_BIDIRECTIONAL_SEQUENCE_LSTM)
TFLITE_OP(Register_CAST)
TFLITE_OP(Register_PRELU)
TFLITE_OP(Register_MAXIMUM)
TFLITE_OP(Register_ARG_MAX)
TFLITE_OP(Register_MINIMUM)
TFLITE_OP(Register_LESS)
TFLITE_OP(Register_NEG)
TFLITE_OP(Register_PADV2)
TFLITE_OP(Register_GREATER)
TFLITE_OP(Register_GREATER_EQUAL)
TFLITE_OP(Register_LESS_EQUAL)
TFLITE_OP(Register_SELECT)
TFLITE_OP(Register_SLICE)
TFLITE_OP(Register_SIN)
TFLITE_OP(Register_TRANSPOSE_CONV)
TFLITE_OP(Register_SPARSE_TO_DENSE)
TFLITE_OP(Register_TILE)
TFLITE_OP(Register_EXPAND_DIMS)
TFLITE_OP(Register_EQUAL)
TFLITE_OP(Register_NOT_EQUAL)
TFLITE_OP(Register_LOG)
TFLITE_OP(Register_SUM)
TFLITE_OP(Register_SQRT)
TFLITE_OP(Register_RSQRT)
TFLITE_OP(Register_SHAPE)
TFLITE_OP(Register_POW)
TFLITE_OP(Register_ARG_MIN)
TFLITE_OP(Register_FAKE_QUANT)
TFLITE_OP(Register_REDUCE_PROD)
TFLITE_OP(Register_REDUCE_MAX)
TFLITE_OP(Register_PACK)
TFLITE_OP(Register_LOGICAL_OR)
TFLITE_OP(Register_ONE_HOT)
TFLITE_OP(Register_LOGICAL_AND)
TFLITE_OP(Register_LOGICAL_NOT)
TFLITE_OP(Register_UNPACK)
TFLITE_OP(Register_REDUCE_MIN)
TFLITE_OP(Register_FLOOR_DIV)
TFLITE_OP(Register_REDUCE_ANY)
TFLITE_OP(Register_SQUARE)
TFLITE_OP(Register_ZEROS_LIKE)
TFLITE_OP(Register_FILL)
TFLITE_OP(Register_FLOOR_MOD)
TFLITE_OP(Register_RANGE)
TFLITE_OP(Register_RESIZE_NEAREST_NEIGHBOR)
TFLITE_OP(Register_LEAKY_RELU)
TFLITE_OP(Register_SQUARED_DIFFERENCE)
TFLITE_OP(Register_MIRROR_PAD)
TFLITE_OP(Register_ABS)
TFLITE_OP(Register_SPLIT_V)
TFLITE_OP(Register_UNIQUE)
TFLITE_OP(Register_CEIL)
TFLITE_OP(Register_REVERSE_V2)
TFLITE_OP(Register_ADD_N)
TFLITE_OP(Register_GATHER_ND)
TFLITE_OP(Register_COS)
TFLITE_OP(Register_WHERE)
TFLITE_OP(Register_RANK)
TFLITE_OP(Register_ELU)
TFLITE_OP(Register_REVERSE_SEQUENCE)
TFLITE_OP(Register_MATRIX_DIAG)
TFLITE_OP(Register_QUANTIZE)
TFLITE_OP(Register_MATRIX_SET_DIAG)
TFLITE_OP(Register_ROUND)
TFLITE_OP(Register_HARD_SWISH)
TFLITE_OP(Register_IF)
TFLITE_OP(Register_WHILE)
TFLITE_OP(Register_NON_MAX_SUPPRESSION_V4)
TFLITE_OP(Register_NON_MAX_SUPPRESSION_V5)
TFLITE_OP(Register_SCATTER_ND)
TFLITE_OP(Register_SELECT_V2)
TFLITE_OP(Register_DENSIFY)
TFLITE_OP(Register_SEGMENT_SUM)
TFLITE_OP(Register_BATCH_MATMUL)
TFLITE_OP(Register_CUMSUM)
TFLITE_OP(Register_CALL_ONCE)
TFLITE_OP(Register_BROADCAST_TO)
TFLITE_OP(Register_RFFT2D)
TFLITE_OP(Register_CONV_3D)
TFLITE_OP(Register_IMAG)
TFLITE_OP(Register_REAL)
TFLITE_OP(Register_COMPLEX_ABS)
TFLITE_OP(Register_HASHTABLE)
TFLITE_OP(Register_HASHTABLE_FIND)
TFLITE_OP(Register_HASHTABLE_IMPORT)
TFLITE_OP(Register_HASHTABLE_SIZE)
TFLITE_OP(Register_REDUCE_ALL)
TFLITE_OP(Register_CONV_3D_TRANSPOSE)
TFLITE_OP(Register_VAR_HANDLE)
TFLITE_OP(Register_READ_VARIABLE)
TFLITE_OP(Register_ASSIGN_VARIABLE)
TFLITE_OP(Register_BROADCAST_ARGS)
TFLITE_OP(Register_RANDOM_STANDARD_NORMAL)
TFLITE_OP(Register_BUCKETIZE)
TFLITE_OP(Register_RANDOM_UNIFORM)
TFLITE_OP(Register_MULTINOMIAL)
TFLITE_OP(Register_GELU)
TFLITE_OP(Register_DYNAMIC_UPDATE_SLICE)
